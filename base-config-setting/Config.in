## base-config-setting/Config.in
```kconfig
if PACKAGE_base-config-setting
comment "Configuration"

config BASE_CONFIG_SETTING_LUCI_LOGIN
	string
	prompt "Set the default login username for luci"
	default "root"

comment "Packages"

endif
```
